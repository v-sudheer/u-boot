## arch/arm/mach-aspeed/Kconfig
```kconfig
if ARCH_ASPEED

menu "ASPEED AST SoC Architectures"

choice
        prompt "ASPEED Processor Family"
        default CONFIG_MACH_ASPEED_G5

config MACH_ASPEED_G3
	select CPU_ARM926EJS
        bool "Aspeed SoC 3rd Generation"

config MACH_ASPEED_G4
	select CPU_ARM926EJS
        bool "Aspeed SoC 4th Generation"

config MACH_ASPEED_G5
	select CPU_ARM1176
	select SUPPORT_SPL
        bool "Aspeed SoC 5th Generation"

config MACH_ASPEED_G6
	select SUPPORT_SPL
	bool "Aspeed SoC 6th Generation"

endchoice

config SLT_ASPEED
	bool "SLT"

config FPGA_ASPEED
	bool "FPGA"

config PALLADIUM
    bool "Build uboot for Palladium"

config ASPEED_ESPI
	bool "ESPI"

config AST_CVIC
	bool "AST CVIC"

config AST_SCU_LOCK
	bool "AST SCU Protection Key"

config AST1070_UART_DMA
	bool

config AST_UART_SDMA
	bool

endmenu 

if MACH_ASPEED_G6

config ARM1176
	select CPU_ARM1176
	bool "CPU ARM1176"

config CORTEX_A7
	select CPU_V7
	select CPU_V7_HAS_NONSEC
	select ARCH_SUPPORT_PSCI
	select EXPERT
	bool "CPU Cortex-A7"
endif

endif
```

## arch/arm/mach-aspeed/Kconfig.cam
```kconfig
if ARCH_ASPEED

menu "ASPEED AST SoC Selection"

choice
        prompt "ASPEED Processor Family"
        default CONFIG_RT360_CAM

config RT360_CAM
	bool "Real Time 360 CAM"

endchoice

if RT360_CAM

choice
	prompt "Real Time 360 Cam Serials"
	default CONFIG_ARCH_AST1220

config ARCH_AST1220
	select CPU_ARM1176
	bool "AST1220"

endchoice

endif

config FPGA_ASPEED
	bool "FPGA"

config AST_CVIC
	bool "AST CVIC"

config AST_SCU_LOCK
	bool "AST SCU Protection Key"

config AST1070_UART_DMA
	bool

config AST_UART_SDMA
	bool

endmenu 

endif
```

## arch/arm/mach-pilot/Kconfig
```kconfig
if ARCH_PILOT

config SYS_BOARD
	default "pilot"

config SYS_VENDOR
	default "aspeed"

config SYS_SOC
	default "pilot"

config SYS_CONFIG_NAME
	string "Board configuration name"
	default "pilot"
	help
	This option contains information about board configuration name.
	Based on this option include/configs/<CONFIG_SYS_CONFIG_NAME>.h header
	will be used for board configuration.

config ENABLE_PILOT_SPI
        bool "Configure SPI Controllers and Banks"
        depends on ARCH_PILOT
        help
          Say Y here to enable/disable SPI controllers and banks 
          for pilot4 in U-Boot.

config MAX_BOOT_SPI_BANKS
        hex "Number of SPI devices connected to BOOT SPI Controller"
        default 0x1
	depends on ENABLE_PILOT_SPI
        help
          Set the number of SPI devices connected to BOOT SPI Controller
		Maximum value is 3

endif
```

## board/aspeed/ast-cam/Kconfig
```kconfig
if ARCH_AST1220

config SYS_CPU
	default "arm1176"

config SYS_BOARD
	default "ast-cam"

config SYS_VENDOR
	default "aspeed"

config SYS_SOC
	default "aspeed"

config SYS_CONFIG_NAME
	string "Board configuration name"
	default "ast-cam"

endif
```

## board/aspeed/ast-g4/Kconfig
```kconfig
if ARCH_AST2400

config SYS_CPU
	default "arm926ejs"

config SYS_BOARD
	default "ast-g4"

config SYS_VENDOR
	default "aspeed"

config SYS_SOC
	default "aspeed"

config SYS_CONFIG_NAME
	default "ast-g4"

endif
```

## board/aspeed/ast-g6/Kconfig
```kconfig
if MACH_ASPEED_G6

if CPU_ARM1176

config SYS_CPU
	default "arm1176"

endif

if CPU_V7

config SYS_CPU
	default "armv7"

endif

config SYS_BOARD
	default "ast-g6"

config SYS_VENDOR
	default "aspeed"

config SYS_SOC
	default "aspeed"

config SYS_CONFIG_NAME
	string "Board configuration name"
	default "ast-g6"

endif
```

## configs/ast2600_openbmc_defconfig
```kconfig
CONFIG_ARM=y
CONFIG_ARCH_ASPEED=y
CONFIG_MACH_ASPEED_G6=y
CONFIG_CORTEX_A7=y
CONFIG_ARMV7_BOOT_SEC_DEFAULT=y
CONFIG_ARMV7_PSCI_NR_CPUS=2
CONFIG_ARMV7_LPAE=y
# CONFIG_MMC is not set
CONFIG_SYS_TEXT_BASE=0x0
# CONFIG_LOCALVERSION_AUTO is not set
CONFIG_FIT=y
CONFIG_FIT_VERBOSE=y
CONFIG_HUSH_PARSER=y
CONFIG_SYS_PROMPT="ast# "
CONFIG_CMD_MEMTEST=y
CONFIG_CMD_MEMINFO=y
# CONFIG_CMD_FLASH is not set
CONFIG_CMD_SF=y
CONFIG_CMD_I2C=y
CONFIG_CMD_NETTEST=y
CONFIG_CMD_DHCP=y
CONFIG_CMD_MII=y
CONFIG_CMD_PING=y
CONFIG_CMD_FAT=y
CONFIG_NET_RANDOM_ETHADDR=y
CONFIG_SPI_FLASH=y
CONFIG_SPI_FLASH_MACRONIX=y
CONFIG_SPI_FLASH_SPANSION=y
CONFIG_SPI_FLASH_WINBOND=y
CONFIG_SPI_FLASH_MTD=y
CONFIG_RTL8211X_PHY_FORCE_MASTER=y
CONFIG_NETDEVICES=y
CONFIG_FTGMAC100=y
CONFIG_SYS_NS16550=y
CONFIG_FMC_SPI=y
CONFIG_OF_LIBFDT=y
# CONFIG_EFI_LOADER is not set
```

## configs/pilot_defconfig
```kconfig
CONFIG_ARM=y
CONFIG_SYS_L2CACHE_OFF=y
CONFIG_ARCH_PILOT=y
CONFIG_ENABLE_PILOT_SPI=y
CONFIG_MAX_BOOT_SPI_BANKS=0x2
CONFIG_DEFAULT_DEVICE_TREE="pilot"
CONFIG_FIT=y
CONFIG_FIT_VERBOSE=y
CONFIG_FIT_SIGNATURE=y
CONFIG_BOOTDELAY=3
CONFIG_HUSH_PARSER=y
CONFIG_SYS_PROMPT="pilot> "
# CONFIG_CMD_IMLS is not set
# CONFIG_CMD_FLASH is not set
CONFIG_CMD_SF=y
# CONFIG_CMD_FPGA is not set
# CONFIG_CMD_SETEXPR is not set
CONFIG_CMD_TFTPPUT=y
CONFIG_CMD_DHCP=y
CONFIG_CMD_MII=y
CONFIG_CMD_PING=y
CONFIG_CMD_CACHE=y
CONFIG_CMD_EXT2=y
CONFIG_CMD_EXT4=y
CONFIG_CMD_EXT4_WRITE=y
CONFIG_CMD_FAT=y
CONFIG_CMD_FS_GENERIC=y
CONFIG_OF_EMBED=y
CONFIG_NET_RANDOM_ETHADDR=y
CONFIG_MTD=y
CONFIG_SPI_FLASH=y
CONFIG_SPI_FLASH_BAR=y
CONFIG_SPI_FLASH_ATMEL=y
CONFIG_SPI_FLASH_EON=y
CONFIG_SPI_FLASH_GIGADEVICE=y
CONFIG_SPI_FLASH_MACRONIX=y
CONFIG_SPI_FLASH_SPANSION=y
CONFIG_SPI_FLASH_STMICRO=y
CONFIG_SPI_FLASH_SST=y
CONFIG_SPI_FLASH_WINBOND=y
CONFIG_SPI_FLASH_DATAFLASH=y
CONFIG_SPI_FLASH_MTD=y
CONFIG_NETDEVICES=y
CONFIG_PILOT4_MAC=y
CONFIG_SYS_NS16550=y
CONFIG_PILOT_SPI=y
```

## drivers/memory/Kconfig
```kconfig
#
# Memory devices
#

menu "Memory Controller drivers"

config AST_SDMC
	bool "ASPEED DRAM Controller"
	depends on (MACH_ASPEED_G3 || MACH_ASPEED_G4 || MACH_ASPEED_G5 || MACH_ASPEED_G6)

config DRAM_ECC
	bool "DRAM ECC Enable"
	depends on AST_SDMC

if MACH_ASPEED_G5

choice 
	prompt "DRAM Speed"
	default DRAM_1600

config DRAM_1600
	bool "DRAM 1600"

config DRAM_1333
	bool "DRAM 1333"

endchoice

endif

config DRAM_ECC_SIZE
        hex "DRAM ECC Size"
        depends on DRAM_ECC
        default 0x10000000
	
config TI_AEMIF
	tristate "Texas Instruments AEMIF driver"
	depends on ARCH_KEYSTONE
	help
	  This driver is for the AEMIF module available in Texas Instruments
	  SoCs. AEMIF stands for Asynchronous External Memory Interface and
	  is intended to provide a glue-less interface to a variety of
	  asynchronuous memory devices like ASRAM, NOR and NAND memory. A total
	  of 256M bytes of any of these memories can be accessed at a given
	  time via four chip selects with 64M byte access per chip select.

endmenu
```
